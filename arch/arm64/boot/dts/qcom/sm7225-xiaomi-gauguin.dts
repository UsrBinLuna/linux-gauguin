// SPDX-License-Identifier: BSD-3-Clause
/*
 * Copyright (c) 2023, Luna Cuneo <zephyr1112@protonmail.com>
 */

/dts-v1/;

#include <dt-bindings/gpio/gpio.h>
#include <dt-bindings/iio/qcom,spmi-adc7-pmk8350.h>
#include <dt-bindings/input/input.h>
#include <dt-bindings/leds/common.h>
#include <dt-bindings/pinctrl/qcom,pmic-gpio.h>
#include <dt-bindings/regulator/qcom,rpmh-regulator.h>
#include "sm7225.dtsi"
#include "pm6150l.dtsi"
#include "pm6350.dtsi"
#include "pm7250b.dtsi"

/ {

	model = "Xiaomi Mi 10T Lite / Mi 10i / Redmi Note 9 Pro 5G";
	compatible = "xiaomi,gauguin", "xiaomi,gauguininpro", "xiaomi,gauguinpro" "qcom,sm7225", "qcom,lagoon";
	chassis-type = "handset";

	/* required for bootloader to select correct board */
	qcom,board-id = <0x23 0>;


	chosen {
		#address-cells = <2>;
		#size-cells = <2>;
		ranges;

		stdout-path = "serial0:115200n8";

		framebuffer0: framebuffer@a000000 {
			compatible = "simple-framebuffer";
			reg = <0 0xa0000000 0 (2340 * 1080 * 4)>;
			width = <1080>;
			height = <2340>;
			stride = <(1080 * 4)>;
			format = "a8r8g8b8";
		};
	};
};